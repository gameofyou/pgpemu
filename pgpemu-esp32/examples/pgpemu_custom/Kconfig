## pgpemu-esp32/examples/pgpemu_custom/Kconfig
```kconfig
menu "PGPemu Custom"

config PGPEMU_CUSTOM
   bool "Enable customisation"
   default 1
   help
     Enable custom keys, and splash screen 

endmenu
```

## pgpemu-esp32/sdkconfig.defaults
```kconfig
# Override some defaults so BT stack is enabled
# in this example

#
# BT config
#
CONFIG_BT_ENABLED=y

#
# ESP32-specific config
#
CONFIG_ESP32_ENABLE_STACK_BT=y
# CONFIG_ESP32_ENABLE_STACK_NONE is not set
CONFIG_MEMMAP_BT=y

CONFIG_ESP32_XTAL_FREQ_AUTO=y
CONFIG_ESP32_XTAL_FREQ=0

# CONFIG_ESPTOOLPY_FLASHSIZE_4MB=y
# CONFIG_ESPTOOLPY_FLASHSIZE="4MB"

# CONFIG_ESP_MAIN_TASK_STACK_SIZE=8192
```
